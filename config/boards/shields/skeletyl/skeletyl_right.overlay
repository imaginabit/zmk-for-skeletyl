/*
 * Copyright (c) 2020 The ZMK Contributors
 *
 * SPDX-License-Identifier: MIT
 */

#include "skeletyl.dtsi"

&default_transform {
    col-offset = <5>;
};

&kscan0 {
    col-gpios                                            // espejo de la izquierda
        = <&pro_micro  8 (GPIO_ACTIVE_HIGH | GPIO_PULL_DOWN)>   // P1.04
        , <&pro_micro  7 (GPIO_ACTIVE_HIGH | GPIO_PULL_DOWN)>   // P0.11
        , <&pro_micro  6 (GPIO_ACTIVE_HIGH | GPIO_PULL_DOWN)>   // P1.00
        , <&pro_micro 10 (GPIO_ACTIVE_HIGH | GPIO_PULL_DOWN)>   // P0.09
        , <&pro_micro 20 (GPIO_ACTIVE_HIGH | GPIO_PULL_DOWN)>   // P0.29
        ;
};
